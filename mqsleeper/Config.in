## mqsleeper/Config.in
```kconfig
config BR2_PACKAGE_MQSLEEPER
	bool "mqsleeper"
	help
	  Program which exist and prints "Ostritch" upon receiving a UDP packet.

	  https://github.com/omeh-a/tor-scripts
```

## tester_wait/Config.in
```kconfig
config BR2_PACKAGE_TESTER_WAIT
	bool "tester_wait"
	help
	  
	  Simple program which waits for a UDP message on port 1345.

	  https://github.com/omeh-a/tor-scripts
```

## utecho/Config.in
```kconfig
config BR2_PACKAGE_UTECHO
	bool "utecho"
	help
	  Simply echo program for UDP / TCP. This program listens to UDP or TDP given a port, simply echoing back packets it receives. UDP will simply bounce back everything, while TCP will wait on a client to close the connection before accepting a new client.


	  https://github.com/omeh-a/tor-scripts
```
